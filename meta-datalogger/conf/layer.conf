## meta-datalogger/conf/layer.conf
```bitbake
# We have a conf and classes directory, add to BBPATH
BBPATH .= ":${LAYERDIR}"

# We have recipes-* directories, add to BBFILES
BBFILES += "${LAYERDIR}/recipes-*/*/*.bb \
            ${LAYERDIR}/recipes-*/*/*.bbappend"

BBFILE_COLLECTIONS += "meta-datalogger"
BBFILE_PATTERN_meta-datalogger = "^${LAYERDIR}/"
BBFILE_PRIORITY_meta-datalogger = "10"

LAYERDEPENDS_meta-datalogger = ""
LAYERSERIES_COMPAT_meta-datalogger = "kirkstone"
```
